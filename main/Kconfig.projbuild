## main/Kconfig.projbuild
```kconfig
menu "LoRa Configuration"

    config CS_GPIO
        int "CS GPIO"
        range 0 35
        default 15
        help
        Pin Number where the NCS pin of the LoRa module is connected to.
    
    config RST_GPIO
        int "RST GPIO"
        range 0 35
        default 32
        help
        Pin Number where the NRST pin of the LoRa module is connected to.
    
    config MISO_GPIO
        int "MISO GPIO"
        range 0 35
        default 13
        help
        Pin Number to be used as the MISO SPI signal.
    
    config MOSI_GPIO
        int "MOSI GPIO"
        range 0 35
        default 12
        help
        Pin Number to be used as the MOSI SPI signal.
    
    config SCK_GPIO
        int "SCK GPIO"
        range 0 35
        default 14
        help
        Pin Number to be used as the SCK SPI signal.

  
    endmenu
    
    menu "MQTT Configuration"

        config BROKER_URL
            string "Broker URL"
            default "mqtt://mqtt.tago.io"
            help
                URL of the broker to connect to
    
        config BROKER_URL_FROM_STDIN
            bool
            default y if BROKER_URL = "FROM_STDIN"
    
        endmenu
    
    menu "Wifi Configuration"
    
        config ESP_WIFI_SSID
            string "WiFi SSID"
            default "Unifique(Maria)"
            help
                SSID (network name) for the example to connect to.
    
        config ESP_WIFI_PASSWORD
            string "WiFi Password"
            default "UNFQ528807"
            help
                WiFi password (WPA or WPA2) for the example to use.
        config ESP_WIFI_CHANNEL
            int "WiFi Channel"
            range 1 13
            default 1
            help
                WiFi channel (network channel) for the example to use.
    
        config ESP_MAX_STA_CONN
            int "Maximal STA connections"
            default 4
            help
                Max number of the STA connects to AP.
    endmenu
    
    
```
